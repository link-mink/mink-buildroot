## Config.in
```kconfig
source "$BR2_EXTERNAL_MINKOS_PATH/package/mink_core/Config.in"
source "$BR2_EXTERNAL_MINKOS_PATH/package/ndpi/Config.in"
```

## configs/globalscale_espressobin_mink_defconfig
```kconfig
BR2_aarch64=y
BR2_cortex_a53=y
BR2_ARM_FPU_VFPV4=y

# Linux headers same as kernel, a 5.15 series
BR2_PACKAGE_HOST_LINUX_HEADERS_CUSTOM_5_15=y

# Kernel
BR2_LINUX_KERNEL=y
BR2_LINUX_KERNEL_CUSTOM_VERSION=y
BR2_LINUX_KERNEL_CUSTOM_VERSION_VALUE="5.15.1"
BR2_LINUX_KERNEL_USE_ARCH_DEFAULT_CONFIG=y
BR2_LINUX_KERNEL_CONFIG_FRAGMENT_FILES="board/globalscale/espressobin/linux-extras.config $(BR2_EXTERNAL_MINKOS_PATH)/board/espressobin_mink/kernel/kernel.config"
BR2_LINUX_KERNEL_DTS_SUPPORT=y
BR2_LINUX_KERNEL_INTREE_DTS_NAME="marvell/armada-3720-espressobin marvell/armada-3720-espressobin-emmc marvell/armada-3720-espressobin-v7 marvell/armada-3720-espressobin-v7-emmc marvell/armada-3720-espressobin-ultra"
BR2_LINUX_KERNEL_INSTALL_TARGET=y
BR2_LINUX_KERNEL_NEEDS_HOST_OPENSSL=y
BR2_GLOBAL_PATCH_DIR="$(BR2_EXTERNAL_MINKOS_PATH)/board/espressobin_mink/patches"

# Filesystem
BR2_TARGET_ROOTFS_EXT2=y
BR2_TARGET_ROOTFS_EXT2_4=y
BR2_TARGET_ROOTFS_EXT2_SIZE="160M"
BR2_TARGET_ROOTFS_TAR_GZIP=y
BR2_PACKAGE_HOST_GENIMAGE=y
BR2_ROOTFS_POST_IMAGE_SCRIPT="support/scripts/genimage.sh"
BR2_ROOTFS_POST_SCRIPT_ARGS="-c board/globalscale/espressobin/genimage.cfg"
BR2_ROOTFS_OVERLAY="$(BR2_EXTERNAL_MINKOS_PATH)/board/espressobin_mink/overlay/"
BR2_ROOTFS_POST_BUILD_SCRIPT="$(BR2_EXTERNAL_MINKOS_PATH)/board/espressobin_mink/post-build.sh"

# firmware
BR2_PACKAGE_LINUX_FIRMWARE=y

# mink os
BR2_ROOTFS_MERGED_USR=y
BR2_TARGET_GENERIC_HOSTNAME="mink-os"
BR2_TARGET_GENERIC_ISSUE="Welcome to mINK OS"
BR2_TARGET_GENERIC_PASSWD_SHA256=y
BR2_TARGET_GENERIC_PASSWD_METHOD="sha-256"
BR2_TARGET_ENABLE_ROOT_LOGIN=y
BR2_TARGET_GENERIC_ROOT_PASSWD=""
BR2_TOOLCHAIN_BUILDROOT_GLIBC=y
BR2_TOOLCHAIN_USES_GLIBC=y
BR2_TOOLCHAIN_BUILDROOT_CXX=y
BR2_USE_WCHAR=y
BR2_PACKAGE_BUSYBOX_SHOW_OTHERS=y
BR2_PACKAGE_NETCAT_OPENBSD=y
BR2_PACKAGE_OPENSSH=y
BR2_PACKAGE_OPENSSH_CLIENT=y
BR2_PACKAGE_OPENSSH_SERVER=y
BR2_PACKAGE_OPENSSH_KEY_UTILS=y
BR2_PACKAGE_LIBNFTNL=y
BR2_PACKAGE_NFTABLES=y
BR2_PACKAGE_IPROUTE2=y
BR2_USE_MMU=y
BR2_INIT_SYSTEMD=y
BR2_PACKAGE_SKELETON_INIT_SYSTEMD=y
BR2_PACKAGE_SYSTEMD_NETWORKD=y
BR2_PACKAGE_SYSTEMD_RESOLVED=y
BR2_SYSTEM_BIN_SH_BASH=y
BR2_PACKAGE_BASH=y
BR2_SYSTEM_BIN_SH="bash"
BR2_PACKAGE_IWD=y
BR2_PACKAGE_MINK_CORE=y
BR2_PACKAGE_MINK_CORE_SYSAGENT=y
BR2_PACKAGE_MINK_CORE_SYSAGENT_LUA=y
BR2_PACKAGE_MINK_CORE_SYSAGENT_MQTT=y
BR2_PACKAGE_MOSQUITTO=y
BR2_PACKAGE_MOSQUITTO_BROKER=y
```

## configs/raspberrypi2_mink_defconfig
```kconfig
BR2_arm=y
BR2_cortex_a7=y
BR2_ARM_EABIHF=y
BR2_ARM_FPU_NEON_VFPV4=y

BR2_TOOLCHAIN_BUILDROOT_CXX=y

BR2_SYSTEM_DHCP="eth0"

# Linux headers same as kernel, a 5.10 series
BR2_PACKAGE_HOST_LINUX_HEADERS_CUSTOM_5_10=y

BR2_LINUX_KERNEL=y
BR2_LINUX_KERNEL_CUSTOM_TARBALL=y
BR2_LINUX_KERNEL_CUSTOM_TARBALL_LOCATION="$(call github,raspberrypi,linux,0b54dbda3cca2beb51e236a25738784e90853b64)/linux-0b54dbda3cca2beb51e236a25738784e90853b64.tar.gz"
BR2_LINUX_KERNEL_DEFCONFIG="bcm2709"

# Build the DTB from the kernel sources
BR2_LINUX_KERNEL_DTS_SUPPORT=y
BR2_LINUX_KERNEL_INTREE_DTS_NAME="bcm2709-rpi-2-b"

BR2_LINUX_KERNEL_NEEDS_HOST_OPENSSL=y

BR2_PACKAGE_RPI_FIRMWARE=y
BR2_PACKAGE_RPI_FIRMWARE_BOOTCODE_BIN=y
BR2_PACKAGE_RPI_FIRMWARE_VARIANT_PI=y
BR2_PACKAGE_RPI_FIRMWARE_CONFIG_FILE="board/raspberrypi/config_default.txt"
# BR2_PACKAGE_RPI_FIRMWARE_INSTALL_DTB_OVERLAYS is not set

# Required tools to create the SD image
BR2_PACKAGE_HOST_DOSFSTOOLS=y
BR2_PACKAGE_HOST_GENIMAGE=y
BR2_PACKAGE_HOST_MTOOLS=y

# Filesystem / image
BR2_TARGET_ROOTFS_EXT2=y
BR2_TARGET_ROOTFS_EXT2_4=y
BR2_TARGET_ROOTFS_EXT2_SIZE="120M"
# BR2_TARGET_ROOTFS_TAR is not set
BR2_ROOTFS_POST_IMAGE_SCRIPT="board/raspberrypi2/post-image.sh"
BR2_ROOTFS_OVERLAY="$(BR2_EXTERNAL_MINKOS_PATH)/board/raspberrypi2_mink/overlay/"
BR2_ROOTFS_POST_BUILD_SCRIPT="board/raspberrypi2/post-build.sh $(BR2_EXTERNAL_MINKOS_PATH)/board/raspberrypi2_mink/post-build.sh"

# firmware
BR2_PACKAGE_BRCMFMAC_SDIO_FIRMWARE_RPI=y
BR2_PACKAGE_BRCMFMAC_SDIO_FIRMWARE_RPI_WIFI=y
BR2_PACKAGE_LINUX_FIRMWARE=y
BR2_PACKAGE_LINUX_FIRMWARE_RALINK_RT2XX=y

# mink os
BR2_ROOTFS_MERGED_USR=y
BR2_TARGET_GENERIC_HOSTNAME="mink-os"
BR2_TARGET_GENERIC_ISSUE="Welcome to mINK OS"
BR2_TARGET_GENERIC_PASSWD_SHA256=y
BR2_TARGET_GENERIC_PASSWD_METHOD="sha-256"
BR2_TARGET_ENABLE_ROOT_LOGIN=y
BR2_TARGET_GENERIC_ROOT_PASSWD=""
BR2_TOOLCHAIN_BUILDROOT_GLIBC=y
BR2_TOOLCHAIN_USES_GLIBC=y
BR2_USE_WCHAR=y
BR2_PACKAGE_BUSYBOX_SHOW_OTHERS=y
BR2_PACKAGE_NETCAT_OPENBSD=y
BR2_PACKAGE_OPENSSH=y
BR2_PACKAGE_OPENSSH_CLIENT=y
BR2_PACKAGE_OPENSSH_SERVER=y
BR2_PACKAGE_OPENSSH_KEY_UTILS=y
BR2_PACKAGE_LIBNFTNL=y
BR2_PACKAGE_NFTABLES=y
BR2_PACKAGE_IPROUTE2=y
BR2_USE_MMU=y
BR2_INIT_SYSTEMD=y
BR2_PACKAGE_SKELETON_INIT_SYSTEMD=y
BR2_PACKAGE_SYSTEMD_NETWORKD=y
BR2_PACKAGE_SYSTEMD_RESOLVED=y
BR2_SYSTEM_BIN_SH_BASH=y
BR2_PACKAGE_BASH=y
BR2_SYSTEM_BIN_SH="bash"
BR2_PACKAGE_IWD=y
BR2_PACKAGE_MINK_CORE=y
BR2_PACKAGE_MINK_CORE_SYSAGENT=y
BR2_PACKAGE_MINK_CORE_SYSAGENT_LUA=y
BR2_PACKAGE_MINK_CORE_SYSAGENT_MQTT=y
BR2_PACKAGE_MOSQUITTO=y
BR2_PACKAGE_MOSQUITTO_BROKER=y
```

## package/link_mink_core/Config.in
```kconfig
menuconfig BR2_PACKAGE_LINK_MINK_CORE
	bool "link_mink_core"
	depends on BR2_INSTALL_LIBSTDCPP
	depends on BR2_USE_WCHAR
        select BR2_PACKAGE_NCURSES
        select BR2_PACKAGE_LKSCTP_TOOLS
        select BR2_PACKAGE_LIBCAP
        select BR2_PACKAGE_PROCPS_NG
        select BR2_PACKAGE_BOOST
        select BR2_PACKAGE_BOOST_FILESYSTEM
        select BR2_PACKAGE_OPENSSL
        select BR2_PACKAGE_LIBOPENSSL
        select BR2_PACKAGE_ZLIB
        select BR2_PACKAGE_SQLITE

	help
	  mINK Framework

	  https://github.com/link-mink/mink-core


if BR2_PACKAGE_LINK_MINK_CORE

    menu "mINK Core Daemons"

        config BR2_PACKAGE_LINK_MINK_CORE_SYSAGENT
                bool "mink_sysagentd"
                help
                  mINK System Agent Daemon

        config BR2_PACKAGE_LINK_MINK_CORE_JRPCD
                bool "mink_jrpcd"
                help
                  mINK JSON RPC 2.0 Daemon

        config BR2_PACKAGE_LINK_MINK_CORE_GRPCD
                bool "mink_grpcd"
                select BR2_PACKAGE_GRPC
                help
                  mINK gRPC Daemon

        config BR2_PACKAGE_LINK_MINK_CORE_GDTTRAPC
                bool "mink_gdttrapc"
                help
                  mINK GDT Trap Client

        config BR2_PACKAGE_LINK_MINK_CORE_CODEGEN
                bool "mink_codegen"
                help
                  mINK Code Generator

        config BR2_PACKAGE_LINK_MINK_CORE_CFGD
                bool "mink_cfgd"
                help
                  mINK Config Daemon


    endmenu

    if BR2_PACKAGE_LINK_MINK_CORE_SYSAGENT

        menu "mINK System Agent Plugins"

            config BR2_PACKAGE_LINK_MINK_CORE_SYSAGENT_SYSLOG
                    bool "mink_sysagent_plg_syslog"
                    help
                      syslog plugin

            config BR2_PACKAGE_LINK_MINK_CORE_SYSAGENT_LUA
                    bool "mink_sysagent_plg_lua"
                    select BR2_PACKAGE_LUAJIT
                    help
                      LuaJIT plugin (Lua support)

            config BR2_PACKAGE_LINK_MINK_CORE_SYSAGENT_MQTT
                    bool "mink_sysagent_plg_mqtt"
                    select BR2_PACKAGE_PAHO_MQTT_C
                    help
                      MQTT plugin

            config BR2_PACKAGE_LINK_MINK_CORE_SYSAGENT_NDPI
                    bool "mink_sysagent_plg_ndpi"
                    select BR2_PACKAGE_NDPI
                    help
                      nDPI plugin

            config BR2_PACKAGE_LINK_MINK_CORE_SYSAGENT_CGROUP2
                    bool "mink_sysagent_plg_cgroup2"
                    help
                      cgroup2 plugin

            config BR2_PACKAGE_LINK_MINK_CORE_SYSAGENT_UNIX
                    bool "mink_sysagent_plg_unix"
                    help
                      UNIX socket RPC plugin

            config BR2_PACKAGE_LINK_MINK_CORE_SYSAGENT_SYSTEMD
                    bool "mink_sysagent_plg_systemd"
                    help
                      systemd plugin (sdbus)

            config BR2_PACKAGE_LINK_MINK_CORE_SYSAGENT_CFG_HNDLR
                    bool "mink_sysagent_plg_cfg_hndlr"
                    help
                      mINK configd plugin

            config BR2_PACKAGE_LINK_MINK_CORE_SYSAGENT_MODBUS
                    bool "mink_sysagent_plg_modbus"
                    help
                      modbus plugin

        endmenu

    endif


    if BR2_PACKAGE_LINK_MINK_CORE_JRPCD

        menu "mink jrpcd options"

            config BR2_PACKAGE_LINK_MINK_CORE_JRPCD_WS
                bool "mink_jrpcd_ws"
                help
                  mINK JRPCD Plain WebSocket support (ws://)

            config BR2_PACKAGE_LINK_MINK_CORE_JRPCD_TLS12
                bool "mink_jrpcd_tls12"
                help
                  mINK JRPCD TLSv1.2 suppport

            config BR2_PACKAGE_LINK_MINK_CORE_JRPCD_SS
                bool "mink_jrpcd_ss"
                help
                  mINK JRPCD Single user session

        endmenu

    endif

endif
```

## package/ndpi/Config.in
```kconfig
menuconfig BR2_PACKAGE_NDPI
	bool "ndpi"
        select BR2_PACKAGE_LIBPCAP

	help
	  nDPI

	  https://github.com/ntop/nDPI
```
